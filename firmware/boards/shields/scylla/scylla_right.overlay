#include "scylla.dtsi"

/ {
    zmk,split-role = "right";
};

&scylla_transform {
    col-offset = <6>;
};

&kscan {
    row-gpios = <
        &gpio0 24 GPIO_ACTIVE_HIGH
        &gpio1  0 GPIO_ACTIVE_HIGH
        &gpio0 11 GPIO_ACTIVE_HIGH
        &gpio1 04 GPIO_ACTIVE_HIGH
        &gpio1  6 GPIO_ACTIVE_HIGH
    >;

    col-gpios = <
        &gpio0  9 (GPIO_ACTIVE_HIGH | GPIO_PULL_DOWN)
        &gpio0 10 (GPIO_ACTIVE_HIGH | GPIO_PULL_DOWN)
        &gpio1 11 (GPIO_ACTIVE_HIGH | GPIO_PULL_DOWN)
        &gpio1 13 (GPIO_ACTIVE_HIGH | GPIO_PULL_DOWN)
        &gpio1 15 (GPIO_ACTIVE_HIGH | GPIO_PULL_DOWN)
        &gpio0  2 (GPIO_ACTIVE_HIGH | GPIO_PULL_DOWN)
    >;
};
