#include "scylla-layout.dtsi"

/ {
    chosen {
        zmk,physical-layout = &scylla_layout;
        zmk,kscan = &kscan;
    };

    kscan: kscan {
        compatible = "zmk,kscan-gpio-matrix";
        diode-direction = "col2row";
    };
};
